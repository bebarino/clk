## Documentation/devicetree/bindings/chrome/google,cros-ec-typec.yaml
```yaml
# SPDX-License-Identifier: (GPL-2.0-only OR BSD-2-Clause)
%YAML 1.2
---
$id: http://devicetree.org/schemas/chrome/google,cros-ec-typec.yaml#
$schema: http://devicetree.org/meta-schemas/core.yaml#

title: Google Chrome OS EC(Embedded Controller) Type C port driver.

maintainers:
  - Benson Leung <bleung@chromium.org>
  - Prashant Malani <pmalani@chromium.org>

description:
  Chrome OS devices have an Embedded Controller(EC) which has access to
  Type C port state. This node is intended to allow the host to read and
  control the Type C ports. The node for this device should be under a
  cros-ec node like google,cros-ec-spi.

properties:
  compatible:
    const: google,cros-ec-typec

  '#address-cells':
    const: 1

  '#size-cells':
    const: 0

  mux-gpios:
    description: GPIOs indicating which way the DP mux is steered
    maxItems: 1

  ports:
    $ref: /schemas/graph.yaml#/properties/ports

    properties:
      port@0:
        $ref: /schemas/graph.yaml#/$defs/port-base
        description: Input port to receive DisplayPort (DP) data
        unevaluatedProperties: false

        properties:
          endpoint@0:
            $ref: /schemas/graph.yaml#/$defs/endpoint-base
            description: DisplayPort data for the 1st type-c port
            unevaluatedProperties: false
            properties:
              no-hpd:
                description: Indicates this endpoint doesn't signal HPD for DisplayPort
                type: boolean
              orientation:
                description:
                  Indicates this endpoint assigns lanes based on altmode and
                  type-c port orientation
                type: boolean
              data-lanes:
                $ref: /schemas/types.yaml#/definitions/uint32-array
                description: |
                  An array of physical DP data lane indexes
                  - 0 is DP ML0 lane
                  - 1 is DP ML1 lane
                  - 2 is DP ML2 lane
                  - 3 is DP ML3 lane
                oneOf:
                  - items:
                      - const: 0
                      - const: 1
                  - items:
                      - const: 0
                      - const: 1
                      - const: 2
                      - const: 3

          endpoint@1:
            $ref: /schemas/graph.yaml#/$defs/endpoint-base
            description: DisplayPort data for the 2nd type-c port
            unevaluatedProperties: false
            properties:
              no-hpd:
                description: Indicates this endpoint doesn't signal HPD for DisplayPort
                type: boolean
              orientation:
                description:
                  Indicates this endpoint assigns lanes based on altmode and
                  type-c port orientation
              data-lanes:
                $ref: /schemas/types.yaml#/definitions/uint32-array
                description: |
                  An array of physical DP data lane indexes
                  - 0 is DP ML0 lane
                  - 1 is DP ML1 lane
                  - 2 is DP ML2 lane
                  - 3 is DP ML3 lane
                oneOf:
                  - items:
                      - const: 0
                      - const: 1
                  - items:
                      - const: 0
                      - const: 1
                      - const: 2
                      - const: 3

          endpoint@2:
            $ref: /schemas/graph.yaml#/$defs/endpoint-base
            description: DisplayPort data for the 3rd type-c port
            unevaluatedProperties: false
            properties:
              no-hpd:
                description: Indicates this endpoint doesn't signal HPD for DisplayPort
                type: boolean
              orientation:
                description:
                  Indicates this endpoint assigns lanes based on altmode and
                  type-c port orientation
              data-lanes:
                $ref: /schemas/types.yaml#/definitions/uint32-array
                description: |
                  An array of physical DP data lane indexes
                  - 0 is DP ML0 lane
                  - 1 is DP ML1 lane
                  - 2 is DP ML2 lane
                  - 3 is DP ML3 lane
                oneOf:
                  - items:
                      - const: 0
                      - const: 1
                  - items:
                      - const: 0
                      - const: 1
                      - const: 2
                      - const: 3

          endpoint@3:
            $ref: /schemas/graph.yaml#/$defs/endpoint-base
            description: DisplayPort data for the 4th type-c port
            unevaluatedProperties: false
            properties:
              no-hpd:
                description: Indicates this endpoint doesn't signal HPD for DisplayPort
                type: boolean
              orientation:
                description:
                  Indicates this endpoint assigns lanes based on altmode and
                  type-c port orientation
              data-lanes:
                $ref: /schemas/types.yaml#/definitions/uint32-array
                description: |
                  An array of physical DP data lane indexes
                  - 0 is DP ML0 lane
                  - 1 is DP ML1 lane
                  - 2 is DP ML2 lane
                  - 3 is DP ML3 lane
                oneOf:
                  - items:
                      - const: 0
                      - const: 1
                  - items:
                      - const: 0
                      - const: 1
                      - const: 2
                      - const: 3

          endpoint@4:
            $ref: /schemas/graph.yaml#/$defs/endpoint-base
            description: DisplayPort data for the 5th type-c port
            unevaluatedProperties: false
            properties:
              no-hpd:
                description: Indicates this endpoint doesn't signal HPD for DisplayPort
                type: boolean
              orientation:
                description:
                  Indicates this endpoint assigns lanes based on altmode and
                  type-c port orientation
              data-lanes:
                $ref: /schemas/types.yaml#/definitions/uint32-array
                description: |
                  An array of physical DP data lane indexes
                  - 0 is DP ML0 lane
                  - 1 is DP ML1 lane
                  - 2 is DP ML2 lane
                  - 3 is DP ML3 lane
                oneOf:
                  - items:
                      - const: 0
                      - const: 1
                  - items:
                      - const: 0
                      - const: 1
                      - const: 2
                      - const: 3

          endpoint@5:
            $ref: /schemas/graph.yaml#/$defs/endpoint-base
            description: DisplayPort data for the 6th type-c port
            unevaluatedProperties: false
            properties:
              no-hpd:
                description: Indicates this endpoint doesn't signal HPD for DisplayPort
                type: boolean
              orientation:
                description:
                  Indicates this endpoint assigns lanes based on altmode and
                  type-c port orientation
              data-lanes:
                $ref: /schemas/types.yaml#/definitions/uint32-array
                description: |
                  An array of physical DP data lane indexes
                  - 0 is DP ML0 lane
                  - 1 is DP ML1 lane
                  - 2 is DP ML2 lane
                  - 3 is DP ML3 lane
                oneOf:
                  - items:
                      - const: 0
                      - const: 1
                  - items:
                      - const: 0
                      - const: 1
                      - const: 2
                      - const: 3

          endpoint@6:
            $ref: /schemas/graph.yaml#/$defs/endpoint-base
            description: DisplayPort data for the 7th type-c port
            unevaluatedProperties: false
            properties:
              no-hpd:
                description: Indicates this endpoint doesn't signal HPD for DisplayPort
                type: boolean
              orientation:
                description:
                  Indicates this endpoint assigns lanes based on altmode and
                  type-c port orientation
              data-lanes:
                $ref: /schemas/types.yaml#/definitions/uint32-array
                description: |
                  An array of physical DP data lane indexes
                  - 0 is DP ML0 lane
                  - 1 is DP ML1 lane
                  - 2 is DP ML2 lane
                  - 3 is DP ML3 lane
                oneOf:
                  - items:
                      - const: 0
                      - const: 1
                  - items:
                      - const: 0
                      - const: 1
                      - const: 2
                      - const: 3

          endpoint@7:
            $ref: /schemas/graph.yaml#/$defs/endpoint-base
            description: DisplayPort data for the 8th type-c port
            unevaluatedProperties: false
            properties:
              no-hpd:
                description: Indicates this endpoint doesn't signal HPD for DisplayPort
                type: boolean
              orientation:
                description:
                  Indicates this endpoint assigns lanes based on altmode and
                  type-c port orientation
              data-lanes:
                $ref: /schemas/types.yaml#/definitions/uint32-array
                description: |
                  An array of physical DP data lane indexes
                  - 0 is DP ML0 lane
                  - 1 is DP ML1 lane
                  - 2 is DP ML2 lane
                  - 3 is DP ML3 lane
                oneOf:
                  - items:
                      - const: 0
                      - const: 1
                  - items:
                      - const: 0
                      - const: 1
                      - const: 2
                      - const: 3

          endpoint@8:
            $ref: /schemas/graph.yaml#/$defs/endpoint-base
            description: DisplayPort data for the 9th type-c port
            unevaluatedProperties: false
            properties:
              no-hpd:
                description: Indicates this endpoint doesn't signal HPD for DisplayPort
                type: boolean
              orientation:
                description:
                  Indicates this endpoint assigns lanes based on altmode and
                  type-c port orientation
              data-lanes:
                $ref: /schemas/types.yaml#/definitions/uint32-array
                description: |
                  An array of physical DP data lane indexes
                  - 0 is DP ML0 lane
                  - 1 is DP ML1 lane
                  - 2 is DP ML2 lane
                  - 3 is DP ML3 lane
                oneOf:
                  - items:
                      - const: 0
                      - const: 1
                  - items:
                      - const: 0
                      - const: 1
                      - const: 2
                      - const: 3

        anyOf:
          - required:
              - endpoint@0
          - required:
              - endpoint@1
          - required:
              - endpoint@2
          - required:
              - endpoint@3
          - required:
              - endpoint@4
          - required:
              - endpoint@5
          - required:
              - endpoint@6
          - required:
              - endpoint@7
          - required:
              - endpoint@8

      port@1:
        $ref: /schemas/graph.yaml#/$defs/port-base
        unevaluatedProperties: false
        description:
          Input port to receive USB SuperSpeed (SS) data
        properties:
          endpoint@0:
            $ref: /schemas/graph.yaml#/properties/endpoint
            description: USB SS data for the 1st type-c port

          endpoint@1:
            $ref: /schemas/graph.yaml#/properties/endpoint
            description: USB SS data for the 2nd type-c port

          endpoint@2:
            $ref: /schemas/graph.yaml#/properties/endpoint
            description: USB SS data for the 3rd type-c port

          endpoint@3:
            $ref: /schemas/graph.yaml#/properties/endpoint
            description: USB SS data for the 4th type-c port

          endpoint@4:
            $ref: /schemas/graph.yaml#/properties/endpoint
            description: USB SS data for the 5th type-c port

          endpoint@5:
            $ref: /schemas/graph.yaml#/properties/endpoint
            description: USB SS data for the 6th type-c port

          endpoint@6:
            $ref: /schemas/graph.yaml#/properties/endpoint
            description: USB SS data for the 7th type-c port

          endpoint@7:
            $ref: /schemas/graph.yaml#/properties/endpoint
            description: USB SS data for the 8th type-c port

          endpoint@8:
            $ref: /schemas/graph.yaml#/properties/endpoint
            description: USB SS data for the 9th type-c port

        anyOf:
          - required:
              - endpoint@0
          - required:
              - endpoint@1
          - required:
              - endpoint@2
          - required:
              - endpoint@3
          - required:
              - endpoint@4
          - required:
              - endpoint@5
          - required:
              - endpoint@6
          - required:
              - endpoint@7
          - required:
              - endpoint@8

      port@2:
        $ref: /schemas/graph.yaml#/$defs/port-base
        unevaluatedProperties: false
        description:
          Output port for USB-C data
        properties:
          endpoint@0:
            $ref: /schemas/graph.yaml#/$defs/endpoint-base
            description: USB-C data
            unevaluatedProperties: false
            properties:
              data-lanes:
                $ref: /schemas/types.yaml#/definitions/uint32-array
                description: |
                  An array of physical USB-C data lane indexes.
                  - 0 is SSRX1 lane
                  - 1 is SSTX1 lane
                  - 2 is SSTX2 lane
                  - 3 is SSRX2 lane
                minItems: 4
                maxItems: 4
                items:
                  maximum: 3

          endpoint@1:
            $ref: /schemas/graph.yaml#/$defs/endpoint-base
            description: USB-C data for EC's 1st type-c port
            unevaluatedProperties: false
            properties:
              data-lanes:
                $ref: /schemas/types.yaml#/definitions/uint32-array
                description: |
                  An array of physical USB-C data lane indexes.
                  - 0 is SSRX1 lane
                  - 1 is SSTX1 lane
                  - 2 is SSTX2 lane
                  - 3 is SSRX2 lane
                minItems: 4
                maxItems: 4
                items:
                  maximum: 3

          endpoint@2:
            $ref: /schemas/graph.yaml#/$defs/endpoint-base
            description: USB-C data for EC's 2nd type-c port
            unevaluatedProperties: false
            properties:
              data-lanes:
                $ref: /schemas/types.yaml#/definitions/uint32-array
                description: |
                  An array of physical USB-C data lane indexes.
                  - 0 is SSRX1 lane
                  - 1 is SSTX1 lane
                  - 2 is SSTX2 lane
                  - 3 is SSRX2 lane
                minItems: 4
                maxItems: 4
                items:
                  maximum: 3

          endpoint@3:
            $ref: /schemas/graph.yaml#/$defs/endpoint-base
            description: USB-C data for EC's 3rd type-c port
            unevaluatedProperties: false
            properties:
              data-lanes:
                $ref: /schemas/types.yaml#/definitions/uint32-array
                description: |
                  An array of physical USB-C data lane indexes.
                  - 0 is SSRX1 lane
                  - 1 is SSTX1 lane
                  - 2 is SSTX2 lane
                  - 3 is SSRX2 lane
                minItems: 4
                maxItems: 4
                items:
                  maximum: 3

          endpoint@4:
            $ref: /schemas/graph.yaml#/$defs/endpoint-base
            description: USB-C data for EC's 4th type-c port
            unevaluatedProperties: false
            properties:
              data-lanes:
                $ref: /schemas/types.yaml#/definitions/uint32-array
                description: |
                  An array of physical USB-C data lane indexes.
                  - 0 is SSRX1 lane
                  - 1 is SSTX1 lane
                  - 2 is SSTX2 lane
                  - 3 is SSRX2 lane
                minItems: 4
                maxItems: 4
                items:
                  maximum: 3

          endpoint@5:
            $ref: /schemas/graph.yaml#/$defs/endpoint-base
            description: USB-C data for EC's 5th type-c port
            unevaluatedProperties: false
            properties:
              data-lanes:
                $ref: /schemas/types.yaml#/definitions/uint32-array
                description: |
                  An array of physical USB-C data lane indexes.
                  - 0 is SSRX1 lane
                  - 1 is SSTX1 lane
                  - 2 is SSTX2 lane
                  - 3 is SSRX2 lane
                minItems: 4
                maxItems: 4
                items:
                  maximum: 3

          endpoint@6:
            $ref: /schemas/graph.yaml#/$defs/endpoint-base
            description: USB-C data for EC's 6th type-c port
            unevaluatedProperties: false
            properties:
              data-lanes:
                $ref: /schemas/types.yaml#/definitions/uint32-array
                description: |
                  An array of physical USB-C data lane indexes.
                  - 0 is SSRX1 lane
                  - 1 is SSTX1 lane
                  - 2 is SSTX2 lane
                  - 3 is SSRX2 lane
                minItems: 4
                maxItems: 4
                items:
                  maximum: 3

          endpoint@7:
            $ref: /schemas/graph.yaml#/$defs/endpoint-base
            description: USB-C data for EC's 7th type-c port
            unevaluatedProperties: false
            properties:
              data-lanes:
                $ref: /schemas/types.yaml#/definitions/uint32-array
                description: |
                  An array of physical USB-C data lane indexes.
                  - 0 is SSRX1 lane
                  - 1 is SSTX1 lane
                  - 2 is SSTX2 lane
                  - 3 is SSRX2 lane
                minItems: 4
                maxItems: 4
                items:
                  maximum: 3

          endpoint@8:
            $ref: /schemas/graph.yaml#/$defs/endpoint-base
            description: USB-C data for EC's 8th type-c port
            unevaluatedProperties: false
            properties:
              data-lanes:
                $ref: /schemas/types.yaml#/definitions/uint32-array
                description: |
                  An array of physical USB-C data lane indexes.
                  - 0 is SSRX1 lane
                  - 1 is SSTX1 lane
                  - 2 is SSTX2 lane
                  - 3 is SSRX2 lane
                minItems: 4
                maxItems: 4
                items:
                  maximum: 3

        anyOf:
          - required:
              - endpoint@0
          - required:
              - endpoint@1
          - required:
              - endpoint@2
          - required:
              - endpoint@3
          - required:
              - endpoint@4
          - required:
              - endpoint@5
          - required:
              - endpoint@6
          - required:
              - endpoint@7
          - required:
              - endpoint@8

    required:
      - port@2
    anyOf:
      - required:
          - port@0
      - required:
          - port@1


patternProperties:
  '^connector@[0-9a-f]+$':
    $ref: /schemas/connector/usb-connector.yaml#
    required:
      - reg

required:
  - compatible

allOf:
  - if:
      properties:
        no-hpd: true
      required:
        - no-hpd
    then:
      properties:
        ports:
          required:
            - port@0
  - if:
      properties:
        mux-gpios: true
      required:
        - mux-gpios
    then:
      properties:
        ports:
          required:
            - port@0

additionalProperties: false

examples:
  - |+
    spi {
      #address-cells = <1>;
      #size-cells = <0>;

      cros_ec: ec@0 {
        compatible = "google,cros-ec-spi";
        reg = <0>;
        interrupts = <35 0>;

        typec {
          compatible = "google,cros-ec-typec";

          #address-cells = <1>;
          #size-cells = <0>;

          connector@0 {
            compatible = "usb-c-connector";
            reg = <0>;
            power-role = "dual";
            data-role = "dual";
            try-power-role = "source";

            ports {
              #address-cells = <1>;
              #size-cells = <0>;

              port@0 {
                reg = <0>;
                usb_c0_hs: endpoint {
                  remote-endpoint = <&usb_hub_dfp3_hs>;
                };
              };

              port@1 {
                reg = <1>;
                usb_c0_ss: endpoint {
                  remote-endpoint = <&cros_typec_c0_ss>;
                };
              };
            };
          };

          ports {
            #address-cells = <1>;
            #size-cells = <0>;

            port@0 {
              reg = <0>;
              #address-cells = <1>;
              #size-cells = <0>;

              dp_in: endpoint@0 {
                reg = <0>;
                remote-endpoint = <&dp_phy>;
                data-lanes = <0 1>;
              };
            };

            port@1 {
              reg = <1>;
              #address-cells = <1>;
              #size-cells = <0>;

              usb_in_0: endpoint@0 {
                reg = <0>;
                remote-endpoint = <&usb_ss_0_out>;
              };

              usb_in_1: endpoint@1 {
                reg = <1>;
                remote-endpoint = <&usb_ss_1_out>;
              };
            };

            port@2 {
              reg = <2>;
              #address-cells = <1>;
              #size-cells = <0>;

              cros_typec_c0_ss: endpoint@0 {
                reg = <0>;
                remote-endpoint = <&usb_c0_ss>;
                data-lanes = <0 1 2 3>;
              };

              cros_typec_c1_ss: endpoint@1 {
                reg = <1>;
                remote-endpoint = <&usb_c1_ss>;
                data-lanes = <2 3 0 1>;
              };
            };
          };
        };
      };
    };
```
