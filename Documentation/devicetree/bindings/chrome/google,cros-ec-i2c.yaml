## Documentation/devicetree/bindings/clock/test,clk-parent-data.yaml
```yaml
# SPDX-License-Identifier: (GPL-2.0-only OR BSD-2-Clause)
%YAML 1.2
---
$id: http://devicetree.org/schemas/clock/test,clk-parent-data.yaml#
$schema: http://devicetree.org/meta-schemas/core.yaml#

title: Fake clk provider for clk_parent_data unit tests

maintainers:
  - Stephen Boyd <sboyd@kernel.org>

description:
  A clk provider to test the struct clk_parent_data implementation in the Linux
  kernel.

properties:
  compatible:
    const: test,clk-parent-data

  clocks:
    items:
      - description: Fixed parent
      - description: 50 MHz fixed parent

  clock-names:
    items:
      - const: parent_fwname
      - const: "50"

  "#clock-cells":
    const: 1

required:
  - compatible
  - "#clock-cells"

additionalProperties: false

examples:
  - |
    clock-controller {
      compatible = "test,clk-parent-data";
      #clock-cells = <1>;
      clocks = <&fixed_parent>, <&fixed_50MHz>;
      clock-names = "parent_fwname", "50";
    };
...
```

## Documentation/devicetree/bindings/gpio/google,cros-ec-gpio.yaml
```yaml
# SPDX-License-Identifier: (GPL-2.0-only OR BSD-2-Clause)
%YAML 1.2
---
$id: http://devicetree.org/schemas/gpio/google,cros-ec-gpio.yaml#
$schema: http://devicetree.org/meta-schemas/core.yaml#

title: GPIOs controlled by ChromeOS EC

maintainers:
  - Stephen Boyd <swboyd@chromium.org>

description:
  Google's ChromeOS EC has a gpio controller inside the Embedded Controller
  (EC) and controlled via a host-command interface. The node for this
  device should be under a cros-ec node like google,cros-ec-spi.

properties:
  compatible:
    const: google,cros-ec-gpio

  '#gpio-cells':
    const: 2

  gpio-controller: true

required:
  - compatible
  - '#gpio-cells'
  - gpio-controller

additionalProperties: false

examples:
  - |
    spi {
      #address-cells = <1>;
      #size-cells = <0>;

      cros-ec@0 {
        compatible = "google,cros-ec-spi";
        reg = <0>;
        interrupts = <101 0>;
        gpio {
          compatible = "google,cros-ec-gpio";
          gpio-controller;
          #gpio-cells = <2>;
        };
      };
    };
```

## Documentation/devicetree/bindings/test/test,clk-fixed-rate.yaml
```yaml
# SPDX-License-Identifier: (GPL-2.0-only OR BSD-2-Clause)
%YAML 1.2
---
$id: http://devicetree.org/schemas/test/test,clk-fixed-rate.yaml#
$schema: http://devicetree.org/meta-schemas/core.yaml#

title: KUnit clk fixed rate test clk consumer

maintainers:
  - Stephen Boyd <sboyd@kernel.org>

description:
  A clk consumer of a fixed rate clk used to test the fixed rate clk
  implementation.

properties:
  compatible:
    const: test,clk-fixed-rate

  clocks:
    maxItems: 1

required:
  - compatible
  - clocks

additionalProperties: false

examples:
  - |
    clock-consumer {
      compatible = "test,clk-fixed-rate";
      clocks = <&fixed_clk>;
    };
...
```

## Documentation/devicetree/bindings/test/test,empty.yaml
```yaml
# SPDX-License-Identifier: (GPL-2.0-only OR BSD-2-Clause)
%YAML 1.2
---
$id: http://devicetree.org/schemas/test/test,empty.yaml#
$schema: http://devicetree.org/meta-schemas/core.yaml#

title: Empty node

maintainers:
  - David Gow <davidgow@google.com>
  - Brendan Higgins <brendanhiggins@google.com>

description:
  An empty node to confirm tests can load device tree overlays.

properties:
  compatible:
    const: test,empty

required:
  - compatible

additionalProperties: false

examples:
  - |
    kunit-node {
      compatible = "test,empty";
    };
...
```

## Documentation/devicetree/bindings/usb/google,cros-ec-typec-dp-switch.yaml
```yaml
# SPDX-License-Identifier: (GPL-2.0-only OR BSD-2-Clause)
%YAML 1.2
---
$id: http://devicetree.org/schemas/usb/google,cros-ec-typec-dp-switch.yaml#
$schema: http://devicetree.org/meta-schemas/core.yaml#

title: Google Chrome OS EC(Embedded Controller) USB Type-C DisplayPort Switch

maintainers:
  - Benson Leung <bleung@chromium.org>
  - Prashant Malani <pmalani@chromium.org>
  - Stephen Boyd <swboyd@chromium.org>

description:
  Chrome OS devices have an Embedded Controller(EC) which has access to USB
  Type C switching. This node is intended to allow the OS to control Type C
  signal muxing for USB-C orientation and alternate modes. The node for this
  device should be under a cros-ec node like google,cros-ec-spi.

properties:
  compatible:
    const: google,cros-ec-typec-dp-switch

  mode-switch:
    description: Indicates this device controls altmode switching
    type: boolean

  orientation-switch:
    description: Indicates this device controls orientation switching
    type: boolean

  mux-gpios:
    description: GPIOs indicating which way the DP mux is steered

  no-hpd:
    description: Indicates this device doesn't signal HPD for DisplayPort
    type: boolean

  ports:
    type: object
    description:
      Ports for DisplayPort (DP) and USB input data and USB-C data output
    properties:
      "#address-cells":
        const: 1

      "#size-cells":
        const: 0

      port@0:
        type: object
        description: Input port to receive DisplayPort (DP) data
        properties:
          "#address-cells":
            const: 1

          "#size-cells":
            const: 0

          reg:
            const: 0

          endpoint@0:
            $ref: /schemas/graph.yaml#/$defs/endpoint-base
            description: DisplayPort data
            unevaluatedProperties: false
            properties:
              data-lanes:
                $ref: /schemas/types.yaml#/definitions/uint32-array
                description: |
                  An array of physical DP data lane indexes
                  - 0 is DP ML0 lane
                  - 1 is DP ML1 lane
                  - 2 is DP ML2 lane
                  - 3 is DP ML3 lane
                oneOf:
                  - items:
                      - const: 0
                      - const: 1
                  - items:
                      - const: 0
                      - const: 1
                      - const: 2
                      - const: 3

        required:
          - endpoint@0

        additionalProperties: false

      port@1:
        type: object
        description: Input port to receive USB SuperSpeed (SS) data
        properties:
          "#address-cells":
            const: 1

          "#size-cells":
            const: 0

          reg:
            const: 1

          endpoint@0:
            $ref: /schemas/graph.yaml#/properties/endpoint
            description: USB SuperSpeed data for 1st USB-C output port

          endpoint@1:
            $ref: /schemas/graph.yaml#/properties/endpoint
            description: USB SuperSpeed data for 2nd USB-C output port

        required:
          - endpoint@0

        additionalProperties: false

      port@2:
        type: object
        description: Output port for USB-C data
        properties:
          "#address-cells":
            const: 1

          "#size-cells":
            const: 0

          reg:
            const: 2

        patternProperties:
          "^endpoint@[0-7]$":
            $ref: "#/$defs/usbc-endpoint"
            unevaluatedProperties: false

        anyOf:
          - required:
              - endpoint@0
          - required:
              - endpoint@1
          - required:
              - endpoint@2
          - required:
              - endpoint@3
          - required:
              - endpoint@4
          - required:
              - endpoint@5
          - required:
              - endpoint@6
          - required:
              - endpoint@7

        additionalProperties: false

    required:
      - port@0
      - port@2

    additionalProperties: false

$defs:
  usbc-endpoint:
    $ref: /schemas/graph.yaml#/$defs/endpoint-base
    unevaluatedProperties: false
    description:
      USB-C data for EC's Nth USB type-c port (reg property indicates port number)
    properties:
      data-lanes:
        $ref: /schemas/types.yaml#/definitions/uint32-array
        description: |
          An array of physical USB-C data lane indexes.
          - 0 is SSRX1 lane
          - 1 is SSTX1 lane
          - 2 is SSTX2 lane
          - 3 is SSRX2 lane
        uniqueItems: true
        minItems: 4
        maxItems: 4
        items:
          maximum: 3

required:
  - compatible
  - ports

additionalProperties: false

examples:
  - |
    spi {
      #address-cells = <1>;
      #size-cells = <0>;

      cros_ec: ec@0 {
        compatible = "google,cros-ec-spi";
        reg = <0>;
        interrupts = <35 0>;

        typec-dp-switch-0 {
          compatible = "google,cros-ec-typec-dp-switch";
          mode-switch;
          orientation-switch;

          ports {
            #address-cells = <1>;
            #size-cells = <0>;

            port@0 {
              reg = <0>;
              #address-cells = <1>;
              #size-cells = <0>;
              dp_in: endpoint@0 {
                reg = <0>;
                remote-endpoint = <&dp_phy>;
                data-lanes = <0 1>;
              };
            };

            port@1 {
              reg = <1>;
              #address-cells = <1>;
              #size-cells = <0>;

              usb_in_0: endpoint@0 {
                reg = <0>;
                remote-endpoint = <&usb_ss_0_out>;
              };

              usb_in_1: endpoint@1 {
                reg = <1>;
                remote-endpoint = <&usb_ss_1_out>;
              };
            };

            port@2 {
              reg = <2>;
              #address-cells = <1>;
              #size-cells = <0>;

              cros_typec_c0_ss: endpoint@0 {
                reg = <0>;
                remote-endpoint = <&usb_c0_ss>;
              };

              cros_typec_c1_ss: endpoint@1 {
                reg = <1>;
                remote-endpoint = <&usb_c1_ss>;
                data-lanes = <3 2 0 1>;
              };
            };
          };
        };
      };
    };
...
```
